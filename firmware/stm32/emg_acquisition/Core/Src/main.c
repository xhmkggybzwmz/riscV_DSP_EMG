/* USER CODE BEGIN Header */
/**
  ******************************************************************************
  * @file           : main.c
  * @brief          : Main program body
  ******************************************************************************
  * @attention
  *
  * Copyright (c) 2026 STMicroelectronics.
  * All rights reserved.
  *
  * This software is licensed under terms that can be found in the LICENSE file
  * in the root directory of this software component.
  * If no LICENSE file comes with this software, it is provided AS-IS.
  *
  ******************************************************************************
  */
/* USER CODE END Header */
/* Includes ------------------------------------------------------------------*/
#include "main.h"
#include "adc.h"
#include "dma.h"
#include "tim.h"
#include "usart.h"
#include "spi.h"
#include "gpio.h"

/* Private includes ----------------------------------------------------------*/
/* USER CODE BEGIN Includes */

/* USER CODE END Includes */

/* Private typedef -----------------------------------------------------------*/
/* USER CODE BEGIN PTD */

/* USER CODE END PTD */

/* Private define ------------------------------------------------------------*/
/* USER CODE BEGIN PD */

/* USER CODE END PD */

/* Private macro -------------------------------------------------------------*/
/* USER CODE BEGIN PM */

/* USER CODE END PM */

/* Private variables ---------------------------------------------------------*/

/* USER CODE BEGIN PV */

#define ADC_BUF_LEN 256

uint16_t adc_buffer[ADC_BUF_LEN];

#define ADC_HALF_LEN           (ADC_BUF_LEN / 2)

#define EMG_PROTOCOL_VERSION   1
#define EMG_FORMAT_U16_LE      0x01
#define EMG_CHANNEL_COUNT      1
#define EMG_SAMPLE_RATE_HZ     2000
#define EMG_HEADER_SIZE        20
#define EMG_FRAME_SIZE         (EMG_HEADER_SIZE + ADC_HALF_LEN * 2 + 2)
#define EMG_QUEUE_DEPTH        2
#define EMG_TRANSPORT_UART     0
#define EMG_TRANSPORT_SPI      1
#ifndef EMG_TRANSPORT_MODE
#define EMG_TRANSPORT_MODE     EMG_TRANSPORT_SPI
#endif
#define EMG_SOURCE_ADC         0
#define EMG_SOURCE_TEST        1
#define EMG_SOURCE_REPLAY      2   /* a recording in flash, in a loop; timing still from TIM3 + ADC */
#ifndef EMG_SOURCE_MODE
#define EMG_SOURCE_MODE        EMG_SOURCE_TEST
#endif
#define EMG_SPI_TIMEOUT_MS     20
#define SLOT_FREE              0
#define SLOT_READY             1
#define SLOT_SENDING           2

typedef struct {
    volatile uint32_t captured_blocks;
    volatile uint32_t queued_blocks;
    volatile uint32_t sent_blocks;
    volatile uint32_t dropped_blocks;
    volatile uint32_t transport_errors;
    volatile uint32_t transport_timeouts;
} emg_transport_stats_t;

static uint8_t emg_frames[EMG_QUEUE_DEPTH][EMG_FRAME_SIZE];
static volatile uint8_t emg_slot_state[EMG_QUEUE_DEPTH];
static volatile uint8_t emg_producer;
static volatile uint8_t emg_consumer;
static volatile uint8_t emg_spi_busy;
static volatile uint8_t emg_spi_slot = 0xff;
#if EMG_TRANSPORT_MODE == EMG_TRANSPORT_SPI
static uint32_t emg_spi_started_ms;
#endif
static uint32_t emg_capture_index;
#if EMG_SOURCE_MODE == EMG_SOURCE_TEST
static uint16_t emg_test_value;
#endif
#if EMG_SOURCE_MODE == EMG_SOURCE_REPLAY
#include "emg_replay.h"     /* generated by scripts/sw/gen_stm32_replay.py into build/, real samples: never committed */
#endif
volatile emg_transport_stats_t emg_stats;

/* USER CODE END PV */

/* Private function prototypes -----------------------------------------------*/
void SystemClock_Config(void);
/* USER CODE BEGIN PFP */

/* USER CODE END PFP */

/* Private user code ---------------------------------------------------------*/
/* USER CODE BEGIN 0 */

static void put_u16_le(uint8_t *p, uint16_t value) {
    p[0] = (uint8_t)(value);
    p[1] = (uint8_t)(value >> 8);
}

static void put_u32_le(uint8_t *p, uint32_t value) {
    p[0] = (uint8_t)(value);
    p[1] = (uint8_t)(value >> 8);
    p[2] = (uint8_t)(value >> 16);
    p[3] = (uint8_t)(value >> 24);
}

static uint16_t crc16_update(
    uint16_t crc,
    const uint8_t *data,
    uint32_t length) {
    for (uint32_t i = 0; i < length; i++) {
        crc ^= ((uint16_t)data[i] << 8);

        for (uint8_t bit = 0; bit < 8; bit++) {
            if (crc & 0x8000) {
                crc = (uint16_t)((crc << 1) ^ 0x1021);
            }
            else {
                crc <<= 1;
            }
        }
    }

    return crc;
}

static void EMG_BuildFrame(
    uint8_t *frame,
    const uint16_t *samples,
    uint32_t first_sample_index)
{
    const uint16_t payload_bytes = ADC_HALF_LEN * sizeof(uint16_t);

    /* Magic: "EMG1" */
    frame[0] = 'E'; frame[1] = 'M'; frame[2] = 'G'; frame[3] = '1';

    /* Version */
    frame[4] = EMG_PROTOCOL_VERSION;

    /* Sample format */
    frame[5] = EMG_FORMAT_U16_LE;

    /* Channel count */
    frame[6] = EMG_CHANNEL_COUNT;

    /* Reserved */
    frame[7] = 0;

    /* Sample rate */
    put_u32_le(
        &frame[8],
        EMG_SAMPLE_RATE_HZ
    );

    /* Index of first sample in this packet */
    put_u32_le(
        &frame[12],
        first_sample_index
    );

    /* Samples per channel */
    put_u16_le(
        &frame[16],
        ADC_HALF_LEN
    );

    /* Payload size */
    put_u16_le(
        &frame[18],
        payload_bytes
    );

    for (uint16_t i = 0; i < ADC_HALF_LEN; ++i) {
#if EMG_SOURCE_MODE == EMG_SOURCE_TEST
        const uint16_t value = emg_test_value;
        emg_test_value = (uint16_t)((emg_test_value + 1U) & 0x0FFFU); /* 12 bits, like the ADC */
#elif EMG_SOURCE_MODE == EMG_SOURCE_REPLAY
        /* from the index, not a counter of its own: a block dropped while READY is low must not shift the recording */
        const uint16_t value = emg_replay[(first_sample_index + i) % EMG_REPLAY_N];
#else
        const uint16_t value = samples[i];
#endif
        put_u16_le(&frame[EMG_HEADER_SIZE + (uint32_t)i * 2], value);
    }

    /*
     * CRC16 over:
     * header + payload
     */
    uint16_t crc = 0xFFFF;

    crc = crc16_update(
        crc,
        frame,
        EMG_HEADER_SIZE + payload_bytes
    );
    put_u16_le(&frame[EMG_HEADER_SIZE + payload_bytes], crc);
}

static void EMG_QueueBlock(const uint16_t *samples)
{
    const uint32_t first_index = emg_capture_index;
    const uint8_t slot = emg_producer;
    emg_capture_index += ADC_HALF_LEN;
    emg_stats.captured_blocks++;
    if (emg_slot_state[slot] != SLOT_FREE) {
        emg_stats.dropped_blocks++;
        return;
    }
    EMG_BuildFrame(emg_frames[slot], samples, first_index);
    __DMB();
    emg_slot_state[slot] = SLOT_READY;
    emg_producer = (uint8_t)((slot + 1U) % EMG_QUEUE_DEPTH);
    emg_stats.queued_blocks++;
}

static void EMG_ReleaseSlot(uint8_t slot)
{
    emg_slot_state[slot] = SLOT_FREE;
    emg_consumer = (uint8_t)((slot + 1U) % EMG_QUEUE_DEPTH);
}

static void EMG_TransportPoll(void)
{
    const uint8_t slot = emg_consumer;
#if EMG_TRANSPORT_MODE == EMG_TRANSPORT_SPI
    if (emg_spi_busy) {
        if ((HAL_GetTick() - emg_spi_started_ms) > EMG_SPI_TIMEOUT_MS) {
            const uint32_t primask = __get_PRIMASK();
            __disable_irq();
            /* A completion IRQ may race the timeout test. Recheck while the
             * DMA callback cannot change emg_spi_slot underneath us. */
            if (emg_spi_busy) {
                const uint8_t timed_out_slot = emg_spi_slot;
                EMG_SPI3_Abort();
                HAL_GPIO_WritePin(EMG_SPI_CS_GPIO_Port, EMG_SPI_CS_Pin, GPIO_PIN_SET);
                emg_stats.transport_timeouts++;
                emg_stats.transport_errors++;
                emg_spi_slot = 0xff;
                emg_spi_busy = 0;
                EMG_ReleaseSlot(timed_out_slot);
            }
            if (primask == 0U) __enable_irq();
        }
        return;
    }
    if (emg_slot_state[slot] != SLOT_READY) return;
    if (HAL_GPIO_ReadPin(EMG_SPI_READY_GPIO_Port, EMG_SPI_READY_Pin) != GPIO_PIN_SET) return;
    emg_slot_state[slot] = SLOT_SENDING;
    emg_spi_slot = slot;
    emg_spi_busy = 1;
    emg_spi_started_ms = HAL_GetTick();
    HAL_GPIO_WritePin(EMG_SPI_CS_GPIO_Port, EMG_SPI_CS_Pin, GPIO_PIN_RESET);
    if (EMG_SPI3_Transmit_DMA(emg_frames[slot], EMG_FRAME_SIZE) != HAL_OK) {
        HAL_GPIO_WritePin(EMG_SPI_CS_GPIO_Port, EMG_SPI_CS_Pin, GPIO_PIN_SET);
        emg_stats.transport_errors++;
        EMG_ReleaseSlot(slot);
        emg_spi_slot = 0xff;
        emg_spi_busy = 0;
    }
#else
    if (emg_slot_state[slot] != SLOT_READY) return;
    emg_slot_state[slot] = SLOT_SENDING;
    if (HAL_UART_Transmit(&huart1, emg_frames[slot], EMG_FRAME_SIZE, 100) == HAL_OK)
        emg_stats.sent_blocks++;
    else
        emg_stats.transport_errors++;
    EMG_ReleaseSlot(slot);
#endif
}

/* USER CODE END 0 */

/**
  * @brief  The application entry point.
  * @retval int
  */
int main(void)
{

  /* USER CODE BEGIN 1 */

  /* USER CODE END 1 */

  /* MCU Configuration--------------------------------------------------------*/

  /* Reset of all peripherals, Initializes the Flash interface and the Systick. */
  HAL_Init();

  /* USER CODE BEGIN Init */

  /* USER CODE END Init */

  /* Configure the system clock */
  SystemClock_Config();

  /* USER CODE BEGIN SysInit */

  /* USER CODE END SysInit */

  /* Initialize all configured peripherals */
  MX_GPIO_Init();
  MX_DMA_Init();
  MX_ADC1_Init();
  MX_USART1_UART_Init();
  MX_TIM3_Init();
  MX_SPI3_Init();
  /* USER CODE BEGIN 2 */

  if (HAL_ADC_Start_DMA(&hadc1,
                      (uint32_t *)adc_buffer,
                      ADC_BUF_LEN) != HAL_OK) {
      Error_Handler();
  }

  if (HAL_TIM_Base_Start(&htim3) != HAL_OK) {
      Error_Handler();
  }

  /* USER CODE END 2 */

  /* Infinite loop */
  /* USER CODE BEGIN WHILE */
  while (1)
  {
    EMG_TransportPoll();
    /* USER CODE END WHILE */

    /* USER CODE BEGIN 3 */
  }
  /* USER CODE END 3 */
}

/**
  * @brief System Clock Configuration
  * @retval None
  */
void SystemClock_Config(void)
{
  RCC_OscInitTypeDef RCC_OscInitStruct = {0};
  RCC_ClkInitTypeDef RCC_ClkInitStruct = {0};

  /** Configure the main internal regulator output voltage
  */
  __HAL_RCC_PWR_CLK_ENABLE();
  __HAL_PWR_VOLTAGESCALING_CONFIG(PWR_REGULATOR_VOLTAGE_SCALE1);

  /** Initializes the RCC Oscillators according to the specified parameters
  * in the RCC_OscInitTypeDef structure.
  */
  RCC_OscInitStruct.OscillatorType = RCC_OSCILLATORTYPE_HSI;
  RCC_OscInitStruct.HSIState = RCC_HSI_ON;
  RCC_OscInitStruct.HSICalibrationValue = RCC_HSICALIBRATION_DEFAULT;
  RCC_OscInitStruct.PLL.PLLState = RCC_PLL_NONE;
  if (HAL_RCC_OscConfig(&RCC_OscInitStruct) != HAL_OK)
  {
    Error_Handler();
  }

  /** Initializes the CPU, AHB and APB buses clocks
  */
  RCC_ClkInitStruct.ClockType = RCC_CLOCKTYPE_HCLK|RCC_CLOCKTYPE_SYSCLK
                              |RCC_CLOCKTYPE_PCLK1|RCC_CLOCKTYPE_PCLK2;
  RCC_ClkInitStruct.SYSCLKSource = RCC_SYSCLKSOURCE_HSI;
  RCC_ClkInitStruct.AHBCLKDivider = RCC_SYSCLK_DIV1;
  RCC_ClkInitStruct.APB1CLKDivider = RCC_HCLK_DIV1;
  RCC_ClkInitStruct.APB2CLKDivider = RCC_HCLK_DIV1;

  if (HAL_RCC_ClockConfig(&RCC_ClkInitStruct, FLASH_LATENCY_0) != HAL_OK)
  {
    Error_Handler();
  }
}

/* USER CODE BEGIN 4 */
void HAL_ADC_ConvHalfCpltCallback(ADC_HandleTypeDef *hadc) {
    if (hadc->Instance == ADC1) {
        EMG_QueueBlock(&adc_buffer[0]);
    }
}

void HAL_ADC_ConvCpltCallback(ADC_HandleTypeDef *hadc) {
    if (hadc->Instance == ADC1) {
        EMG_QueueBlock(&adc_buffer[ADC_HALF_LEN]);
    }
}

void EMG_SPI3_TxCpltCallback(void) {
    if (emg_spi_busy) {
        HAL_GPIO_WritePin(EMG_SPI_CS_GPIO_Port, EMG_SPI_CS_Pin, GPIO_PIN_SET);
        emg_stats.sent_blocks++;
        EMG_ReleaseSlot(emg_spi_slot);
        emg_spi_slot = 0xff;
        emg_spi_busy = 0;
    }
}

void EMG_SPI3_ErrorCallback(void) {
    if (emg_spi_busy) {
        HAL_GPIO_WritePin(EMG_SPI_CS_GPIO_Port, EMG_SPI_CS_Pin, GPIO_PIN_SET);
        emg_stats.transport_errors++;
        EMG_ReleaseSlot(emg_spi_slot);
        emg_spi_slot = 0xff;
        emg_spi_busy = 0;
    }
}
/* USER CODE END 4 */

/**
  * @brief  This function is executed in case of error occurrence.
  * @retval None
  */
void Error_Handler(void)
{
  /* USER CODE BEGIN Error_Handler_Debug */
  /* User can add his own implementation to report the HAL error return state */
  __disable_irq();
  while (1)
  {
  }
  /* USER CODE END Error_Handler_Debug */
}
#ifdef USE_FULL_ASSERT
/**
  * @brief  Reports the name of the source file and the source line number
  *         where the assert_param error has occurred.
  * @param  file: pointer to the source file name
  * @param  line: assert_param error line source number
  * @retval None
  */
void assert_failed(uint8_t *file, uint32_t line)
{
  /* USER CODE BEGIN 6 */
  /* User can add his own implementation to report the file name and line number,
     ex: printf("Wrong parameters value: file %s on line %d\r\n", file, line) */
  /* USER CODE END 6 */
}
#endif /* USE_FULL_ASSERT */
