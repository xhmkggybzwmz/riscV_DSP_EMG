`timescale 1ns / 1ps
`default_nettype none

// tb_emg_cnn - E3b CNN RTL (and, with CHAIN defined, DSP + CNN) vs the E2 INT8 reference,
// layer by layer, every element: conv1..3 accumulators (if provided) and activations, GAP sums,
// FC scores, result interface (scores, argmax, window end, seq, timestamp), counts and protocol.
// Plusargs: +vec=<dir> +input=<file> +frames=N +n1/+n2/+n3/+ngap/+nlog=<line counts> +acc=0|1
//           +vpct +rpct +seed ; CHAIN: +ndsp=N (dsp_out.hex lines) +mask=M
// Model files: model_paths.vh (generated by scripts/sim/run_e3.py).

module tb_emg_cnn;
    localparam TB_TIMEOUT_NS = 400000000;
    `include "tb_check.vh"
    `include "model_paths.vh"

    reg clk = 1'b0;
    reg rst = 1'b1;
    always #5 clk = ~clk;

    wire         s_tvalid, s_tready, s_tlast;
    wire [127:0] s_tdata;
    wire [79:0]  s_tuser;
    wire         src_done;
    wire [31:0]  src_sent;
    // CNN input bus
    wire         c_tvalid, c_tready, c_tlast;
    wire [127:0] c_tdata;
    wire [79:0]  c_tuser;

    esi_src_bfm src (.clk(clk), .rst(rst), .tvalid(s_tvalid), .tready(s_tready), .tdata(s_tdata),
                     .tuser(s_tuser), .tlast(s_tlast), .done(src_done), .sent(src_sent));
    wire [31:0] mon_s_err, mon_s_hs, mon_c_err, mon_c_hs;
    esi_monitor #(.NAME("src")) mon_s (.clk(clk), .rst(rst), .tvalid(s_tvalid), .tready(s_tready),
        .tdata(s_tdata), .tuser(s_tuser), .tlast(s_tlast), .errors(mon_s_err), .handshakes(mon_s_hs));

`ifdef CHAIN
    reg  [3:0] cfg_sec_en = 4'b1101;
    wire [31:0] d_in, d_out, d_osat, d_isat, d_res;
    wire d_ovf, d_busy;
    emg_dsp #(.N_CH(4), .N_SEC(4), .COEF_FILE(`DSP_COEF_FILE)) dsp (
        .clk(clk), .rst(rst), .cfg_sec_en(cfg_sec_en), .cfg_clear(1'b0),
        .coef_we(1'b0), .coef_addr(8'd0), .coef_wdata(18'd0),
        .s_tvalid(s_tvalid), .s_tready(s_tready), .s_tdata(s_tdata), .s_tuser(s_tuser), .s_tlast(s_tlast),
        .m_tvalid(c_tvalid), .m_tready(c_tready), .m_tdata(c_tdata), .m_tuser(c_tuser), .m_tlast(c_tlast),
        .stat_frames_in(d_in), .stat_frames_out(d_out), .stat_out_sat(d_osat), .stat_int_sat(d_isat),
        .stat_resets(d_res), .stat_ovf_sticky(d_ovf), .busy(d_busy));
`else
    assign c_tvalid = s_tvalid;
    assign s_tready = c_tready;
    assign c_tdata = s_tdata;
    assign c_tuser = s_tuser;
    assign c_tlast = s_tlast;
`endif
    esi_monitor #(.NAME("cnn in")) mon_c (.clk(clk), .rst(rst), .tvalid(c_tvalid), .tready(c_tready),
        .tdata(c_tdata), .tuser(c_tuser), .tlast(c_tlast), .errors(mon_c_err), .handshakes(mon_c_hs));

    wire         res_valid;
    reg          res_ready = 1'b0;
    wire [191:0] res_scores;
    wire [3:0]   res_argmax;
    wire [31:0]  res_end, res_seq, res_ts, res_count;
    wire [7:0]   res_seg;
    wire         dbg_valid;
    wire [2:0]   dbg_layer;
    wire [5:0]   dbg_ch;
    wire [23:0]  dbg_step;
    wire [7:0]   dbg_seg, dbg_act;
    wire [31:0]  dbg_acc;
    wire [31:0]  st_frames, st_results, st_resets, st_npd, st_sat1, st_sat2, st_sat3;
    wire         busy;

    emg_cnn #(.SETTLE(0),
        .W1_FILE(`W1_FILE), .B1_FILE(`B1_FILE), .M1_FILE(`M1_FILE), .SH1_FILE(`SH1_FILE),
        .W2_FILE(`W2_FILE), .B2_FILE(`B2_FILE), .M2_FILE(`M2_FILE), .SH2_FILE(`SH2_FILE),
        .W3_FILE(`W3_FILE), .B3_FILE(`B3_FILE), .M3_FILE(`M3_FILE), .SH3_FILE(`SH3_FILE),
        .FCW_FILE(`FCW_FILE), .FCB_FILE(`FCB_FILE)) dut (
        .clk(clk), .rst(rst),
        .s_tvalid(c_tvalid), .s_tready(c_tready), .s_tdata(c_tdata), .s_tuser(c_tuser), .s_tlast(c_tlast),
        .res_valid(res_valid), .res_ready(res_ready), .res_scores(res_scores), .res_argmax(res_argmax),
        .res_end(res_end), .res_seq(res_seq), .res_ts(res_ts), .res_seg(res_seg), .res_count(res_count),
        .dbg_valid(dbg_valid), .dbg_layer(dbg_layer), .dbg_ch(dbg_ch), .dbg_step(dbg_step), .dbg_seg(dbg_seg),
        .dbg_acc(dbg_acc), .dbg_act(dbg_act),
        .wr_en(1'b0), .wr_mem(4'd0), .wr_addr(13'd0), .wr_data(32'd0),
        .stat_frames(st_frames), .stat_results(st_results), .stat_resets(st_resets), .stat_not_post_dsp(st_npd),
        .stat_sat1(st_sat1), .stat_sat2(st_sat2), .stat_sat3(st_sat3), .busy(busy));

    // ---------------- golden data ----------------
    reg [175:0]  frames [0:39999];
    reg [159:0]  g_act1 [0:19999];
    reg [287:0]  g_act2 [0:9999];
    reg [287:0]  g_act3 [0:1999];
    reg [543:0]  g_acc1 [0:19999];
    reg [1055:0] g_acc2 [0:9999];
    reg [1055:0] g_acc3 [0:1999];
    reg [543:0]  g_gap  [0:999];
    reg [223:0]  g_log  [0:999];
    reg [71:0]   g_dec  [0:999];
    reg [127:0]  g_dsp  [0:39999];
    integer seg_start [0:255];
    integer nframes, n1, n2, n3, ngap, nlog, ndsp, use_acc, vpct, rpct, mask;
    integer p1, p2, p3, pg, pf, pr, pd, nseg, k, errs, first_err;
    reg [8*512-1:0] vec, fname, infile;

    task fail_at;
        input [8*24-1:0] what;
        input integer layer, ch, step, seg;
        input [31:0] exp, got;
        begin
            errs = errs + 1;
            if (errs <= 10)
                $display("ERROR: first mismatch #%0d: %0s layer=%0d ch=%0d step=%0d seg=%0d exp=%h got=%h (t=%0t)",
                         errs, what, layer, ch, step, seg, exp, got, $time);
        end
    endtask

    // ---------------- debug-trace comparison ----------------
    reg [31:0] e_acc;
    reg [7:0]  e_act;
    reg [23:0] e_step;
    reg [7:0]  e_seg;
    always @(posedge clk) if (!rst && dbg_valid) begin
        case (dbg_layer)
            3'd0: begin
                e_act = g_act1[p1][8*dbg_ch +: 8]; e_step = g_act1[p1][128 +: 24]; e_seg = g_act1[p1][152 +: 8];
                e_acc = g_acc1[p1][32*dbg_ch +: 32];
                if (p1 >= n1) fail_at("conv1 extra output", 1, dbg_ch, dbg_step, dbg_seg, 0, 0);
                else begin
                    if (dbg_act !== e_act) fail_at("conv1 activation", 1, dbg_ch, e_step, e_seg, e_act, dbg_act);
                    if (use_acc && dbg_acc !== e_acc) fail_at("conv1 accumulator", 1, dbg_ch, e_step, e_seg, e_acc, dbg_acc);
                    if (dbg_step !== e_step || dbg_seg !== e_seg) fail_at("conv1 step/seg", 1, dbg_ch, e_step, e_seg, {e_seg, e_step}, {dbg_seg, dbg_step});
                end
                if (dbg_ch == 15) p1 = p1 + 1;
            end
            3'd1: begin
                e_act = g_act2[p2][8*dbg_ch +: 8]; e_step = g_act2[p2][256 +: 24]; e_seg = g_act2[p2][280 +: 8];
                e_acc = g_acc2[p2][32*dbg_ch +: 32];
                if (p2 >= n2) fail_at("conv2 extra output", 2, dbg_ch, dbg_step, dbg_seg, 0, 0);
                else begin
                    if (dbg_act !== e_act) fail_at("conv2 activation", 2, dbg_ch, e_step, e_seg, e_act, dbg_act);
                    if (use_acc && dbg_acc !== e_acc) fail_at("conv2 accumulator", 2, dbg_ch, e_step, e_seg, e_acc, dbg_acc);
                    if (dbg_step !== e_step || dbg_seg !== e_seg) fail_at("conv2 step/seg", 2, dbg_ch, e_step, e_seg, {e_seg, e_step}, {dbg_seg, dbg_step});
                end
                if (dbg_ch == 31) p2 = p2 + 1;
            end
            3'd2: begin
                e_act = g_act3[p3][8*dbg_ch +: 8]; e_step = g_act3[p3][256 +: 24]; e_seg = g_act3[p3][280 +: 8];
                e_acc = g_acc3[p3][32*dbg_ch +: 32];
                if (p3 >= n3) fail_at("conv3 extra output", 3, dbg_ch, dbg_step, dbg_seg, 0, 0);
                else begin
                    if (dbg_act !== e_act) fail_at("conv3 activation", 3, dbg_ch, e_step, e_seg, e_act, dbg_act);
                    if (use_acc && dbg_acc !== e_acc) fail_at("conv3 accumulator", 3, dbg_ch, e_step, e_seg, e_acc, dbg_acc);
                    if (dbg_step !== e_step || dbg_seg !== e_seg) fail_at("conv3 step/seg", 3, dbg_ch, e_step, e_seg, {e_seg, e_step}, {dbg_seg, dbg_step});
                end
                if (dbg_ch == 31) p3 = p3 + 1;
            end
            3'd3: begin
                e_acc = {16'd0, g_gap[pg][16*dbg_ch +: 16]}; e_step = g_gap[pg][512 +: 24]; e_seg = g_gap[pg][536 +: 8];
                if (pg >= ngap) fail_at("GAP extra output", 4, dbg_ch, dbg_step, dbg_seg, 0, 0);
                else begin
                    if (dbg_acc !== e_acc) fail_at("GAP sum", 4, dbg_ch, e_step, e_seg, e_acc, dbg_acc);
                    if (dbg_step !== e_step || dbg_seg !== e_seg) fail_at("GAP end/seg", 4, dbg_ch, e_step, e_seg, {e_seg, e_step}, {dbg_seg, dbg_step});
                end
                if (dbg_ch == 31) pg = pg + 1;
            end
            default: begin
                e_acc = g_log[pf][32*dbg_ch +: 32]; e_step = g_log[pf][192 +: 24]; e_seg = g_log[pf][216 +: 8];
                if (pf >= nlog) fail_at("FC extra output", 5, dbg_ch, dbg_step, dbg_seg, 0, 0);
                else begin
                    if (dbg_acc !== e_acc) fail_at("FC score", 5, dbg_ch, e_step, e_seg, e_acc, dbg_acc);
                    if (dbg_step !== e_step || dbg_seg !== e_seg) fail_at("FC end/seg", 5, dbg_ch, e_step, e_seg, {e_seg, e_step}, {dbg_seg, dbg_step});
                end
                if (dbg_ch == 5) pf = pf + 1;
            end
        endcase
    end

    // ---------------- result interface ----------------
    integer fidx;
    always @(posedge clk) begin
        if (rst) res_ready <= 1'b0;
        else begin
            if (res_valid && res_ready) begin
                if (pr >= nlog) fail_at("extra result", 6, 0, res_end, res_seg, 0, 0);
                else begin
                    if (res_scores !== g_log[pr][191:0]) fail_at("result scores", 6, 0, res_end, res_seg, 0, 1);
                    if (res_argmax !== g_dec[pr][3:0]) fail_at("result argmax", 6, 0, res_end, res_seg, g_dec[pr][3:0], res_argmax);
                    if (res_end[23:0] !== g_dec[pr][63:40] || res_seg !== g_dec[pr][71:64])
                        fail_at("result end/seg", 6, 0, res_end, res_seg, g_dec[pr][71:40], {res_seg, res_end[23:0]});
                    fidx = seg_start[res_seg] + res_end;
                    if (res_ts !== fidx) fail_at("result timestamp", 6, 0, res_end, res_seg, fidx, res_ts);
                    if (res_seq !== frames[fidx][175:144]) fail_at("result seq", 6, 0, res_end, res_seg, frames[fidx][175:144], res_seq);
                    if (res_count !== pr + 1) fail_at("result count", 6, 0, res_end, res_seg, pr + 1, res_count);
                end
                pr = pr + 1;
            end
            res_ready <= (({$random(tb_seed)} % 100) < rpct);
        end
    end

`ifdef CHAIN
    // DSP output on the internal bus vs dsp_out.hex
    always @(posedge clk) if (!rst && c_tvalid && c_tready) begin
        if (pd < ndsp && c_tdata !== g_dsp[pd]) fail_at("DSP output frame", 0, 0, pd, 0, c_tdata[31:0], g_dsp[pd][31:0]);
        if (!c_tuser[6]) fail_at("DSP POST_DSP flag", 0, 0, pd, 0, 1, 0);
        pd = pd + 1;
    end
`endif

    // ---------------- cycle statistics ----------------
    integer cyc, t_acc, busy_cnt, busy_max, busy_frame, last_hs, res_lat, res_lat_max;
    reg     busy_prev, rv_prev;
    initial begin rv_prev = 0; cyc = 0; busy_cnt = 0; busy_max = 0; busy_frame = 0; res_lat_max = 0; busy_prev = 0; end
    always @(posedge clk) begin
        cyc = cyc + 1;
        if (busy) begin busy_cnt = busy_cnt + 1; busy_frame = busy_frame + 1; end
        if (busy_prev && !busy) begin
            if (busy_frame > busy_max) busy_max = busy_frame;
            busy_frame = 0;
        end
        busy_prev = busy;
        if (c_tvalid && c_tready) last_hs = cyc;
        if (res_valid && !rv_prev) begin                    // decision frame handshake -> result valid
            res_lat = cyc - last_hs;
            if (res_lat > res_lat_max) res_lat_max = res_lat;
        end
        rv_prev = res_valid;
    end

    initial begin
        tb_init;
        p1 = 0; p2 = 0; p3 = 0; pg = 0; pf = 0; pr = 0; pd = 0; errs = 0;
        if (!$value$plusargs("vec=%s", vec)) begin tb_fail("no +vec"); tb_finish; end
        if (!$value$plusargs("input=%s", infile)) infile = "cnn_in.hex";
        if (!$value$plusargs("frames=%d", nframes)) nframes = 0;
        if (!$value$plusargs("n1=%d", n1)) n1 = 0;
        if (!$value$plusargs("n2=%d", n2)) n2 = 0;
        if (!$value$plusargs("n3=%d", n3)) n3 = 0;
        if (!$value$plusargs("ngap=%d", ngap)) ngap = 0;
        if (!$value$plusargs("nlog=%d", nlog)) nlog = 0;
        if (!$value$plusargs("ndsp=%d", ndsp)) ndsp = 0;
        if (!$value$plusargs("acc=%d", use_acc)) use_acc = 0;
        if (!$value$plusargs("vpct=%d", vpct)) vpct = 100;
        if (!$value$plusargs("rpct=%d", rpct)) rpct = 100;
        $sformat(fname, "%0s/%0s", vec, infile);
        src.load(fname, nframes);
        $readmemh(fname, frames, 0, nframes - 1);
        nseg = 0;
        for (k = 0; k < nframes; k = k + 1)
            if (frames[k][128] || frames[k][129]) begin seg_start[nseg] = k; nseg = nseg + 1; end
        $sformat(fname, "%0s/conv1_act.hex", vec); $readmemh(fname, g_act1, 0, n1 - 1);
        $sformat(fname, "%0s/conv2_act.hex", vec); $readmemh(fname, g_act2, 0, n2 - 1);
        $sformat(fname, "%0s/conv3_act.hex", vec); $readmemh(fname, g_act3, 0, n3 - 1);
        if (use_acc) begin
            $sformat(fname, "%0s/conv1_acc.hex", vec); $readmemh(fname, g_acc1, 0, n1 - 1);
            $sformat(fname, "%0s/conv2_acc.hex", vec); $readmemh(fname, g_acc2, 0, n2 - 1);
            $sformat(fname, "%0s/conv3_acc.hex", vec); $readmemh(fname, g_acc3, 0, n3 - 1);
        end
        $sformat(fname, "%0s/gap_sum.hex", vec);   $readmemh(fname, g_gap, 0, ngap - 1);
        $sformat(fname, "%0s/logits.hex", vec);    $readmemh(fname, g_log, 0, nlog - 1);
        $sformat(fname, "%0s/decisions.hex", vec); $readmemh(fname, g_dec, 0, nlog - 1);
`ifdef CHAIN
        $sformat(fname, "%0s/dsp_out.hex", vec);   $readmemh(fname, g_dsp, 0, ndsp - 1);
`endif
        src.configure(vpct, 97, tb_seed);
        repeat (5) @(posedge clk);
        #1 rst = 1'b0;
        src.start;
        wait (src_done);
        wait (!busy && pr == nlog);
        repeat (200) @(posedge clk);
        tb_check("errors in layer/result comparison", errs, 0);
        tb_check("conv1 outputs", p1, n1);
        tb_check("conv2 outputs", p2, n2);
        tb_check("conv3 outputs", p3, n3);
        tb_check("GAP outputs", pg, ngap);
        tb_check("FC outputs", pf, nlog);
        tb_check("results", pr, nlog);
        tb_check("CNN frames", st_frames, nframes);
        tb_check("CNN results counter", st_results, nlog);
        tb_check("CNN resets", st_resets, nseg);
        tb_check("source protocol errors", mon_s_err, 0);
        tb_check("CNN input protocol errors", mon_c_err, 0);
        tb_check("CNN input handshakes", mon_c_hs, nframes);
`ifdef CHAIN
        tb_check("DSP frames out", d_out, nframes);
        tb_check("DSP output frames compared", pd, ndsp);
        tb_check("frames without POST_DSP", st_npd, 0);
`endif
        $display("PERF: cnn busy cycles total=%0d per_frame_max=%0d result_latency_max=%0d frames=%0d results=%0d sat=%0d/%0d/%0d",
                 busy_cnt, busy_max, res_lat_max, nframes, nlog, st_sat1, st_sat2, st_sat3);
        tb_finish;
    end
endmodule

`default_nettype wire
